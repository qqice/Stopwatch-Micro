## main/Kconfig.projbuild
```kconfig
menu "Mosaico application power policy"
    config MOSAICO_CST_SLEEP_TRIAL
        bool "Build the unverified, one-shot CST9217 sleep trial"
        depends on IDF_TARGET_ESP32S31
        default n
        help
            Boots OFF. Only a RAM single-use debug touch-sleep 120 lease enables
            the exact D11E/D101/D105 reference candidate. Restore D109 must echo
            09 and a valid released D000 report is required before touch resumes.
            No reset GPIO, rail, NVS, new task or timer. Failed restore may use
            the normal app restart only outside OTA; not a production policy.
    config MOSAICO_UART_FIFO_RECOVERY
        bool "Experimental fixed FIFO UART recovery for interruptible idle waits"
        depends on IDF_TARGET_ESP32S31
        default n
        help
            Fixed UART0 wake FIFO=16, ordinary RXFULL=15, event queue/budget=32.
            The public SDK keeps XTAL and UART0/IOMUX clocks active in sleep.
            This is an experimental recovery candidate, not hardware acceptance.
            No host preamble, GPIO routing, RX timeout or sleep-I/O change. Wake
            configuration is boot-scoped: runtime off does not clear global clock
            settings. Flag disabled preserves ACTIVE_THRESH and queue capacity 8.
    config MOSAICO_EVENT_IDLE_WAIT
        bool "Use interruptible 500 ms app_main waits while safely locked"
        depends on IDF_TARGET_ESP32S31
        default n
        help
            Requires notification array index 1 and exclusive SerialDebug UART0
            ownership plus GPIO7 LOW interrupt readiness. Unsafe/active states
            retain 20 ms polling; awake stays 10 ms. This builds the capability,
            but runtime always boots disabled. RAM-only debug idle-wait on/off
            selects the candidate without changing sleep or radio policy. Flag
            disabled builds cannot enable the candidate at runtime.
    config MOSAICO_STANDBY_AUTO_LIGHT_SLEEP
        bool "Automatically use validated light sleep while Mosaico is locked"
        depends on IDF_TARGET_ESP32S31 && PM_ENABLE
        default n
        help
            Enable the RAM-only normal locked-screen policy. Runtime still requires
            the complete validated safe sleep profile, UART recovery, fixed 160 MHz,
            a stable locked display, no OTA or boot-health work, and radio inactivity.
            Awake/OTA pause the policy; explicit debug standby-sleep off disables it
            until auto CONFIRM or reboot. No NVS setting is written.
    config MOSAICO_LVGL_MONOTONIC_TICK
        bool "Use the Mosaico monotonic LVGL tick with a 1000 ms port timer"
        depends on IDF_TARGET_ESP32S31
        default n
        help
            Use LVGL's public tick callback with the monotonic ESP timer. Capture a
            startup offset under the LVGL mutex to preserve tick continuity. The
            existing port tick timer runs every 1000 ms; no new task or timer is
            created. Touch polling, LVGL handler deadlines, animation, main-loop
            and wireless scheduling are unchanged. Disabled keeps the 10 ms tick.
    config MOSAICO_SLEEP_IO_RETENTION
        bool "Retain only the configured Mosaico panel and control outputs in light sleep"
        depends on IDF_TARGET_ESP32S31
        default n
        help
            After normal HAL setup, disable sleep-mode selection only on validated
            current panel/rail/unused-shutdown output roles. No levels, directions,
            holds, IOMUX functions, shared rails or SDK workaround are changed.
            Readback or role validation failure blocks light sleep. This is not a
            full port of the board 1.2.1 wiring or a generic GPIO-control interface.
endmenu
```
